## Sala_Maquinas/sdkconfig.defaults
```kconfig
# Sala de Maquinas - ESP32 Configuration

# Target chip
CONFIG_IDF_TARGET="esp32"

# Serial flasher config
CONFIG_ESPTOOLPY_FLASHSIZE_4MB=y
CONFIG_ESPTOOLPY_FLASHMODE_DIO=y
CONFIG_ESPTOOLPY_FLASHFREQ_40M=y

# Compiler options
CONFIG_COMPILER_OPTIMIZATION_SIZE=y

# FreeRTOS
CONFIG_FREERTOS_HZ=1000

# Log output
CONFIG_LOG_DEFAULT_LEVEL_INFO=y
CONFIG_LOG_COLORS=y

# Main task stack size
CONFIG_ESP_MAIN_TASK_STACK_SIZE=4096

# ==============================================================================
# Modbus Configuration (esp-modbus)
# ==============================================================================

# Habilitar el soporte de Modbus
CONFIG_FMB_ENABLE=y

# Configurar para Maestro (Master)
CONFIG_FMB_MASTER_SUPPORT=y

# Funciones Modbus (optimizado para VFD - solo registros)
CONFIG_FMB_MASTER_SUPPORT_COIL=n
CONFIG_FMB_MASTER_SUPPORT_DISCRETE=n
CONFIG_FMB_MASTER_SUPPORT_INPUT_REG=y
CONFIG_FMB_MASTER_SUPPORT_HOLDING_REG=y

# Configuración del stack Modbus
CONFIG_FMB_CONTROLLER_STACK_SIZE=4096
CONFIG_FMB_PORT_TASK_PRIO=10

# Timeouts (ajustables según VFD)
CONFIG_FMB_MASTER_TIMEOUT_MS_RESPOND=150
CONFIG_FMB_MASTER_DELAY_MS_CONVERT=10

# UART settings para Modbus RTU
CONFIG_FMB_COMM_MODE_RTU_EN=y
CONFIG_FMB_COMM_MODE_ASCII_EN=n
CONFIG_FMB_COMM_MODE_TCP_EN=n
```
